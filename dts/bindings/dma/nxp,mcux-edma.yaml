## dts/bindings/dma/nxp,mcux-edma.yaml
```yaml
# Copyright (c) 2020,2024 NXP
# SPDX-License-Identifier: Apache-2.0

description: NXP MCUX EDMA controller

compatible: "nxp,mcux-edma"

include: [dma-controller.yaml, reset-device.yaml]

properties:
  clocks:
    type: phandle-array

  reg:
    required: true
    description: |
      Specifies base physical address(s) and size of DMA and respective DMAMUX register(s)
      that routes DMA sources

  interrupts:
    required: true

  dma-channels:
    required: true
    description: |
      Specifies the number of DMA channels supported by the controller.
      This value is used to validate the channel number provided in the
      DMA specifier.

  dma-requests:
    required: true
    description: |
      Indicates the maximum value of the DMA request sources (slots) index supported by
      DMAMUX. This value is used to validate the request source index provided in the
      DMA specifier.

  dma-channel-mask:
    description: |
      Bitmask of the channels that Zephyr can use. Bit n is channel n of the
      DMA API, that is the channel index before the channel-gap is applied.
      If this property is not set, Zephyr can use all the channels.

      A channel with its bit clear is reserved for the firmware, the
      application or another core. dma_request_channel() does not return it,
      the DMA API returns -EINVAL for it, and the driver interrupt handler
      does not touch it.

      The mask has 32 bits, so dma-channels must be 32 or less when this
      property is set.

      The driver still connects and enables the interrupt lines of all the
      channels, and a line can be shared by a reserved channel and a Zephyr
      channel. The driver does not clear the flags of a reserved channel, so
      do not enable the interrupts of a reserved channel on these lines.

      On eDMA v2, EDMA_Init() clears the request enable, interrupt and error
      flags of all the channels. Start a reserved channel only after the
      driver initialization.

  has-dmamux:
    type: boolean
    description: |
      Indicates whether the DMA controller has an integrated DMAMUX.
      If present, the controller includes DMAMUX functionality.

  dmamux-reg-offset:
    type: int
    default: 0
    description:
      The offset value for obtaining DMAMUX register index from DMAMUX channel.
      Default value means DMAMUX channel is identical with DMAMUX register index

  channel-gap:
    type: array
    description: |
      On some platforms, there may be a gap in the channels and
      this array specifies the start and end of a single gap

  nxp,mem2mem:
    type: boolean
    description: If the DMA controller supports memory to memory transfer

  nxp,a-on:
    type: boolean
    description: If the DMA controller supports always on

  irq-shared-offset:
    type: int
    default: 0
    description: |
      Describes an offset between two channels share the same interrupt entry.
      Default value means each channel has separate interrupt entry.

  no-error-irq:
    type: boolean
    description: |
      If the SoCs don't have a separate interrupt id for error IRQ.

  nxp,version:
    type: int
    enum:
      - 2
      - 3
      - 4
      - 5
    description: |
      eDMA IP revision number.

  nxp,channel-preemption:
    type: boolean
    description: |
      Let a higher priority channel suspend a running lower priority channel
      after its current read/write sequence. The driver sets DCHPRIn[ECP] on
      all channels at init. Without this property, a channel that requests
      service waits until the running channel completes its minor loop.
      The hardware has one preemption level: a channel that preempts another
      one cannot be preempted. Preemption needs fixed priority arbitration,
      which is what the driver uses.
      Only eDMA version 2 (nxp,version = <2>) supports this property.

  nxp,channel-priorities:
    type: array
    description: |
      List of <channel priority> pairs that the driver applies at init.
      With fixed priority arbitration, the channel with the higher priority
      value is served first. The channels are arbitrated in groups that have
      one channel for each priority value (for example, two groups of 16 on
      a 32-channel eDMA), and the priorities in a group must be unique. To
      keep them unique, the channel that has the requested priority gets the
      old priority of the listed channel. All other channels keep the reset
      priority, which is the channel number in its group.
      A channel can occur only one time, and two channels of the same group
      cannot request the same priority.
      Example: nxp,channel-priorities = <0 15>, <20 0>;
      Only eDMA version 2 (nxp,version = <2>) supports this property.

  channels-shared-irq-mask:
    type: array
    description: |
      Describes channel enabled mask value on every IRQ.
      The channel number is mapped to the bit value of array element value.
      If the interrupt is shared on one channel number, the correspongding
      bit is set to 1.
      Please note each element of the array must be 32-bit. If there are more
      than 32 channels, add one or more 32-bit elements in array(elements
      should be contiguous). The software will determine the mask value of
      several elements corresponding to the same interrupt according to the
      number of channels.

  "#dma-cells":
    type: int
    required: true
    description: Number of items to expect in a DMAMUX specifier

# - #dma-cells : Must be <2>.
#  The 1st cell specifies the DMA channel which will be used
#  The 2nd cell specifies the request source (slot) ID.
#    See the SoC's reference manual for all the supported request sources.

dma-cells:
  - mux
  - source
```
